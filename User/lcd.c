#include "./BSP/LCD/lcd.h"
#include "lcd.h"

void lcd_scale_debug(){
	for(int x=10;x<=480;x+=10)								//竖线标尺
		if(x%50==0) lcd_draw_line(x,0,x,800,LIGHTBLUE);		//高亮
		else lcd_draw_line(x,0,x,800,DARKBLUE);
	for(int y=10;y<=790;y+=10)								//横线标尺
		if(y%50==0) lcd_draw_line(0,y,480,y,LIGHTBLUE);		//高亮
		else lcd_draw_line(0,y,480,y,DARKBLUE);
}

void lcd_sections_init(){
	lcd_draw_line(240,10,240,790,0x4228);
	lcd_draw_line(10,270,470,270,0x4228);
}

void lcd_logo_init(){
	uint8_t y_start_list[362] = {19, 19, 20, 20, 21, 22, 22, 23, 23, 24, 24, 25, 26,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 19, 19};
	uint8_t y_end_list[362] = {19, 97, 97, 98, 99, 99, 100, 100, 101, 101, 102, 103, 103,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 97, 96};
	uint8_t x_list[362] = {9, 10, 11, 12, 13, 14, 15, 16, 17, 18, 19, 20, 21,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 148, 149};
	for(int i=0;i<362;i++){
		int x=780-x_list[i];
		lcd_draw_line(40+y_start_list[i],x,40+y_end_list[i],x,WHITE);
	}
}

void lcd_char_init(){
	//频谱
	uint8_t ys_1[242] = {11, 22, 28, 10, 20, 28, 3, 9, 18, 28, 2, 17, 28,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 16, 16};
	uint8_t ye_1[242] = {15, 22, 33, 15, 23, 33, 4, 14, 23, 33, 14, 23, 33,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 19, 18};
	uint8_t x_1[242] = {1, 1, 1, 2, 2, 2, 3, 3, 3, 3, 4, 4, 4,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 77, 78};
	for(int i=0;i<242;i++){
		int x=600-x_1[i];
		lcd_draw_line(35+ys_1[i],x,35+ye_1[i],x,0x4b9f);
	}
	//Spectrum
	uint8_t ys_2[215] = {21, 20, 21, 23, 25, 25, 25, 6, 25, 5, 25, 4, 25,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 21, 20};
	uint8_t ye_2[215] = {23, 24, 25, 25, 26, 26, 26, 10, 26, 11, 26, 12, 26,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 21, 21};
	uint8_t x_2[215] = {2, 3, 4, 5, 6, 7, 8, 9, 9, 10, 10, 11, 11,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 132, 133};
	for(int i=0;i<215;i++){
		int x=75+x_2[i];
		lcd_draw_line(x,525+ys_2[i],x,525+ye_2[i],0xfa6f);
	}
	//五线谱
	uint8_t ys_3[233] = {24, 24, 9, 24, 8, 24, 9, 16, 24, 8, 15, 23, 8,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 17, 17};
	uint8_t ye_3[233] = {27, 27, 11, 27, 12, 27, 12, 18, 27, 12, 19, 27, 11,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 19, 18};
	uint8_t x_3[233] = {2, 3, 4, 4, 5, 5, 6, 6, 6, 7, 7, 7, 8,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 86, 87};
	for(int i=0;i<233;i++){
		int x=612-x_3[i];
		lcd_draw_line(275+ys_3[i],x,275+ye_3[i],x,0xcfe0);
	}
	//Stave
	uint8_t ys_4[120] = {20, 20, 20, 22, 24, 24, 24, 5, 24, 4, 24, 3, 24,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 19, 8};
	uint8_t ye_4[120] = {22, 23, 24, 24, 25, 25, 25, 10, 25, 11, 25, 12, 24,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 19, 12};
	uint8_t x_4[120] = {1, 2, 3, 4, 5, 6, 7, 8, 8, 9, 9, 10, 10,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 73, 74};
	for(int i=0;i<120;i++){
		int x=312+x_4[i];
		lcd_draw_line(x,527+ys_4[i],x,527+ye_4[i],0x077f);
	}
	//音符
	uint8_t ys_5[165] = {15, 15, 9, 14, 9, 14, 9, 14, 8, 14, 29, 8, 13,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 14, 13};
	uint8_t ye_5[165] = {17, 18, 9, 17, 10, 17, 11, 16, 10, 16, 29, 10, 16,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 16, 14};
	uint8_t x_5[165] = {4, 5, 6, 6, 7, 7, 8, 8, 9, 9, 9, 10, 10,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 63, 64};
	for(int i=0;i<165;i++){
		int x=615-x_5[i];
		lcd_draw_line(420+ys_5[i],x,420+ye_5[i],x,0x73ae);
	}
	//Note
	uint8_t ys_6[97] = {21, 21, 22, 6, 22, 5, 9, 22, 4, 22, 3, 21, 3,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 18, 9};
	uint8_t ye_6[97] = {22, 23, 23, 11, 23, 7, 11, 23, 5, 23, 4, 22, 3,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 18, 11};
	uint8_t x_6[97] = {1, 2, 3, 4, 4, 5, 5, 5, 6, 6, 7, 7, 8,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 59, 60};
	for(int i=0;i<97;i++){
		int x=353+x_6[i];
		lcd_draw_line(x,588+ys_6[i],x,588+ye_6[i],0xb5b6);
	}
	
	//Melody Wanderer 旋律行者
	uint8_t ys_7[934] = {29, 8, 28, 8, 8, 122, 8, 28, 109, 121, 8, 29, 109,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 74, 74};
	uint8_t ye_7[934] = {29, 9, 29, 29, 29, 123, 14, 29, 112, 122, 18, 30, 113,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 74, 74};
	uint8_t x_7[934] = {4, 5, 5, 6, 7, 7, 8, 8, 8, 8, 9, 9, 9,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 216, 217};
	for(int i=0;i<934;i++){
		int x=240-x_7[i];
		lcd_draw_line(290+ys_7[i],x,290+ye_7[i],x,0xfd5d);
	}
}

void lcd_buttons_init(){
	//开始采音按钮
	lcd_draw_circle(70,185,40,0xB686);
	lcd_draw_circle(70,185,35,0x45CF);
	for(int i=-20;i<=20;i++){
		int length=(i+20)/2+1;
		lcd_draw_line(70-length,180+i,70+length,180+i,0x7DC1);
	}
	//暂停采音按钮
	lcd_draw_circle(70,90,40,0xFD62);			
	lcd_draw_circle(70,90,35,0xE423);
	lcd_draw_rectangle(50,75,90,85,YELLOW);
	lcd_draw_rectangle(50,95,90,105,YELLOW);
	//终止采音按钮
	lcd_draw_circle(175,185,40,RED);			
	lcd_draw_circle(175,185,35,0xA189);
	lcd_draw_rectangle(160,170,190,200,0x9065);
}

int y_start[21],y_end[21];							//不同频率对应的y轴坐标
int bar_heights[21];								//频率条高度
int bar_color[21]={0x0a1f,0x19ff,0x21de,0x31bd,0x39bc,0x499c,0x517b,0x615a,0x6939,0x7939,0x8118,0x90f7,0x98d6,0xa8b6,0xb0b5,0xc094,0xc873,0xd853,0xe032,0xf031,0xf810};
void lcd_spectrum_init(){
	for(int i=0;i<21;i++){
		y_start[i]=475-7*i+1;
		y_end[i]=475-7*i+6;
		bar_heights[i]=5;
		lcd_draw_rectangle(200,y_start[i],205,y_end[i],bar_color[i]);
	}
}

void lcd_spectrum_set_height(int index,int height){
	int origin_height=bar_heights[index];
	if(origin_height<=5 && height<=5) return;
	if(height<=5) height=5;
	if(height>=120) height=120;
	lcd_draw_rectangle( 205-origin_height,y_start[index],
						205-height,y_end[index],
						origin_height>height?BLACK:bar_color[index]);
	bar_heights[index]=height;
}

uint8_t stave[13][75];								//谱子区域对应的点阵状态
uint8_t stave_colored[13][75];						//谱子区域对应的染色状态
int x_start[13],x_end[13];							//不同音调对应的矩形x轴坐标

int note_stamp[14];

void lcd_stave_init(){
	//五线谱的五条线
	lcd_draw_line(330,301,330,509,WHITE);
	lcd_draw_line(350,301,350,509,WHITE);
	lcd_draw_line(370,301,370,509,WHITE);
	lcd_draw_line(390,301,390,509,WHITE);
	lcd_draw_line(410,301,410,509,WHITE);
	for(int i=0;i<13;i++){
		x_start[i]=430-10*i-4;
		x_end[i]=430-10*i+4;
	}
	
	//两条竖线
	lcd_draw_line(306,451,434,451,WHITE);		
	lcd_draw_line(306,301,434,301,WHITE);
	
	//高音谱号	
	int8_t x_list[304]= {0, 0, 1, 1, 2, 2, 3, 3, 4, 4, 5, 5, 6,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 -71, -72};
	int8_t y_start_list[304]= {14, 31, 15, 33, 15, 34, 16, 35, 16, 34, 17, 34, 17,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 30, 32};
	int8_t y_end_list[304]= {22, 49, 23, 47, 24, 45, 24, 43, 25, 36, 26, 36, 27,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 40, 38};

	for(int index=0;index<304;index++){
		int x=370-x_list[index];
		lcd_draw_line(x,517-y_start_list[index],x,517-y_end_list[index],WHITE);
	}
} 

void lcd_stave_note(int pitch){
	lcd_note_press(pitch,1);
	if(pitch<13)
		stave[pitch][0]=1;
}

int pitch_color[13]={0xcfe0,0xbfe2,0xafe5,0x9fc8,0x8fca,0x7fad,0x6fb0,0x57b2,0x4795,0x3798,0x277a,0x177d,0x077f};
void lcd_stave_line(int pitch,int index,int litup){
	int start=x_start[pitch];
	int end=x_end[pitch];
	int y=301+index*2;
	int color=pitch_color[pitch];
	if(litup){
		lcd_draw_line(start,y,end,y,color);
		lcd_draw_line(start,y+1,end,y+1,color);
	}else{
		lcd_draw_line(start,y,end,y,BLACK);
		lcd_draw_line(start,y+1,end,y+1,BLACK);
		if(pitch==2 || pitch==4 || pitch==6 || pitch==8 || pitch==10){
			lcd_draw_point((start+end)/2,y,WHITE);
			lcd_draw_point((start+end)/2,y+1,WHITE);
		}
	}
	stave_colored[pitch][index]=litup;
}

void lcd_stave_update(){
	for(int pitch=0;pitch<13;pitch++){
		int state=stave[pitch][0];
		for(int i=1;i<75;i++){
			int tmp=stave[pitch][i];
			stave[pitch][i]=state;
			state=tmp;
		}
		stave[pitch][0]=0;
		
		for(int i=1;i<75;i++){
			if(stave[pitch][i] && !stave_colored[pitch][i])
				lcd_stave_line(pitch,i,1);
			if(!stave[pitch][i] && stave_colored[pitch][i])
				lcd_stave_line(pitch,i,0);
		}
	}
}

int note_pos[7];
void lcd_note_init(){
	lcd_draw_rectangle(290,655,350,760,WHITE);
	lcd_draw_rectangle(380,655,440,760,WHITE);
	for(int i=0;i<8;i++){
		int y=655+i*15;
		lcd_draw_rectangle(290,y,350,y+1,BLACK);
		lcd_draw_rectangle(380,y,440,y+1,BLACK);
		if(i==1 || i==2 || i==3 || i==5 || i==6){
			lcd_draw_rectangle(290,y-5,325,y+6,BLACK);
			lcd_draw_rectangle(380,y-5,415,y+6,BLACK);
		}
		if(i<7) note_pos[6-i]=y+14;
	}
}

int sta=0;

void lcd_note_press(int pitch,int press){
	if(!sta) return;
	int x=326,y=note_pos[pitch%7];
	if(pitch>=7) x+=90;
	lcd_draw_rectangle(x+9,y-3,x+15,y-9,press?DARKBLUE:WHITE);
}

void clear(){
	for(int pitch=0;pitch<13;pitch++){
		for(int index=1;index<75;index++){
			lcd_stave_line(pitch,index,0);
			stave[pitch][index]=0;
			stave_colored[pitch][index]=0;
		}
		lcd_note_press(pitch,0);
	}
	lcd_note_press(13,0);
} 

void start(){
	sta=1;
}
void stop(){
	sta=0;
}
